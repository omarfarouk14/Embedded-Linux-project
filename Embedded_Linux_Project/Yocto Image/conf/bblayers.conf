## Embedded_Linux_Project/Yocto Image/conf/bblayers.conf
```bitbake
# POKY_BBLAYERS_CONF_VERSION is increased each time build/conf/bblayers.conf
# changes incompatibly
POKY_BBLAYERS_CONF_VERSION = "2"

BBPATH = "${TOPDIR}"
BBFILES ?= ""

BBLAYERS ?= " \
  /home/newir529/yocto/yocto/poky/meta \
  /home/newir529/yocto/yocto/poky/meta-poky \
  /home/newir529/yocto/yocto/poky/meta-yocto-bsp \
  /home/newir529/yocto/yocto/meta-my-recipes-layer \
  /home/newir529/yocto/yocto/meta-openembedded/meta-oe \
  /home/newir529/yocto/yocto/meta-client-layer \
  "
```

## Embedded_Linux_Project/Yocto Image/meta-client-layer/conf/layer.conf
```bitbake
# We have a conf and classes directory, add to BBPATH
BBPATH .= ":${LAYERDIR}"

# We have recipes-* directories, add to BBFILES
BBFILES += "${LAYERDIR}/recipes-*/*/*.bb \
            ${LAYERDIR}/recipes-*/*/*.bbappend"

BBFILE_COLLECTIONS += "meta-client-layer"
BBFILE_PATTERN_meta-client-layer = "^${LAYERDIR}/"
BBFILE_PRIORITY_meta-client-layer = "6"

LAYERDEPENDS_meta-client-layer = "core"
LAYERSERIES_COMPAT_meta-client-layer = "kirkstone"
```
